;c)	Viết chương trình thực hiện lấy mẫu tín hiệu đưa vào ADC0 và gửi lên máy tính sử dụng UART0 với khung truyền như sau sau mỗi 1s. Thời gian 1s tạo ra bằng hàm delay hoặc timer.
.EQU ADC_PORT=PORTA
.EQU ADC_DR=DDRA
.EQU ADC_IN=PINA
.ORG 0
RJMP MAIN
.ORG 0X40
MAIN:
LDI R16, HIGH(RAMEND)
OUT SPH, R16
LDI R16, LOW(RAMEND)
OUT SPL, R16
LDI R16, 0xFF ;PortD, B output
OUT DDRD, R16
OUT DDRB, R16
LDI R16, 0x00 ;PortA input
OUT ADC_DR, R16
OUT PORTD, R16 ;output=0x0000
OUT PORTB, R16
LDI R16, 0b01000000 ;Vref=AVcc=5V, SE ADC0
STS ADMUX, R16 ; x1,dịch phải
LDI R16, 0b10000110 ;cho phép ADC,mode 1 lần.
STS ADCSRA, R16 ;f(ADC)=fosc/64=125Khz
RCALL SETUART
START:
LDS R16, ADCSRA
ORI R16, (1<<ADSC) ;bắt đầu chuyển đổi
STS ADCSRA, R16
WAIT:
LDS R16, ADCSRA ;đọc cờ ADIF
SBRS R16, ADIF ;cờ ADIF=1 chuyển đổi xong
RJMP WAIT ;chờ cờ ADIF=1
STS ADCSRA, R16 ;xóa cờ ADIF
LDS R1, ADCL ;đọc byte thấp ADC
LDS R0, ADCH ;đọc byte cao ADC
LDI R17,'A'
RCALL PHAT
LDI R17,'D'
RCALL PHAT
LDI R17,'C'
RCALL PHAT
LDI R17,':'
RCALL PHAT
MOV R17,R0
RCALL TACHKITU
MOV R17,R1
RCALL TACHKITU
LDI R17,' '
RCALL PHAT
RCALL DELAY1S
RJMP START ;tiếp tục chuyển đổi



SETUART:
LDI R16, (1<<TXEN0) ;cho phép phát
STS UCSR0B, R16
LDI R16, (1<<UCSZ01)|(1<<UCSZ00)
;8-bit data, không parity, 1 stop bit
STS UCSR0C, R16
LDI R16, 0x00
STS UBRR0H, R16
LDI R16, 51 ;9600 baud rate
STS UBRR0L, R16
RET



PHAT:
LDS R16,UCSR0A
SBRS R16,UDRE0 ; KIEM TRA CO TRONG KHONG
RJMP PHAT ; NEU CHUA TRONG THI TIEP TUC KIEM TRA LAI
STS UDR0,R17 ; KHI TRONG THI CHEP DU LIEU VAO UDR0
RET


DELAY1S:
LDI R16,200
LP1: LDI R17,160
LP2: LDI R18,50
LP3: DEC R18
NOP
BRNE LP3
DEC R17
BRNE LP2
DEC R16
BRNE LP1
RET


;HEX_ASC chuyển từ mã Hex sang mã ASCII
;Input R17=mã Hex,Output R18=mã ASCII
;------------------------------------------
HEX_ASC:CPI R17,0X0A
BRCS NUM
LDI R18,0X37
RJMP CHAR
NUM: LDI R18,0X30
CHAR: ADD R18,R17
RET



TACHKITU :
MOV R15,R17
LDI R16,0XF0
AND R17,R16 ; GIU LAI BIT CAO
SWAP R17
RCALL HEX_ASC
MOV R17,R18
RCALL PHAT
MOV R17,R15
ANDI R17,0X0F
RCALL HEX_ASC
MOV R17,R18
RCALL PHAT
RET
